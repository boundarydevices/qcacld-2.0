## drivers/net/wireless/qcacld-2.0/Kconfig
```kconfig
comment "Qualcomm Atheros CLD WLAN module"

config QCA_CLD_WLAN
	tristate "Qualcomm Atheros CLD WLAN module"
	default n
	help
	Add support for the Qualcomm Atheros CLD WLAN module

if QCA_CLD_WLAN != n

config CLD_HL_SDIO_CORE
	bool "Enable the SDIO support"
	default n

config PRIMA_WLAN_BTAMP
	bool "Enable the Prima WLAN BT-AMP feature"
	default n

config PRIMA_WLAN_LFR
	bool "Enable the Prima WLAN Legacy Fast Roaming feature"
	default n

config PRIMA_WLAN_OKC
	bool "Enable the Prima WLAN Opportunistic Key Caching feature"
	default n

config PRIMA_WLAN_11AC_HIGH_TP
	bool "Enable the Prima WLAN 802.11ac High Throughput option (depends upon kernel support)"
	default n

config WLAN_FEATURE_11W
	bool "Enable the WLAN 802.11w Protected Management Frames feature"
	default n

config WLAN_FEATURE_LPSS
	bool "Enable the WLAN LPSS feature"
	default n

config QCOM_TDLS
	bool "Enable TDLS feature"
	default n

config QCOM_VOWIFI_11R
	bool "Enable Fast Transition (11r) feature"
	default n

config ENABLE_LINUX_REG
	bool "Enable linux regulatory feature"
	default n

config FEATURE_NAN
	bool "Enable NAN feature"
	default n

config WLAN_SYNC_TSF
	bool "Enable QCOM sync multi devices tsf feature"
	default n

config WLAN_UDP_RESPONSE_OFFLOAD
	bool "Enable UDP response offload feature"
	default n

config WLAN_WOW_PULSE
	bool "Enable WOW Pulse feature"
	default n

endif # PRIMA_WLAN || PRONTO_WLAN
```
